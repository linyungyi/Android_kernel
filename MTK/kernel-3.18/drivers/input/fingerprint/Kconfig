## MTK/kernel-3.18/drivers/input/fingerprint/Kconfig
```kconfig
#
#Fingerprint
#
menu "Fingerprint support"
	depends on INPUT

config MTK_FINGERPRINT_SUPPORT
	bool "Mediatek Fingerprint"
	default y
	---help---
	Fingerprint mtk driver enable/disable in the kernel.
	Say Y here if you want to use mediatek fingerprint driver,
	fingerprint driver will support fingerprint function in REE,
	it supports FPC's 102x/104x device.

if MTK_FINGERPRINT_SUPPORT
config MTK_FINGERPRINT_SELECT
	string "sensor type"
	default "ZFS1096"
	#default "FPC1145"
	#default "GF318M"

if MTK_FINGERPRINT_SELECT = "ZFS1096"
config ZET_FINGERPRINT
	bool "ZET Fingerprint"
	default y
	---help---
	ZET Fingerprint chip ZFS1096 REE driver.
endif

if MTK_FINGERPRINT_SELECT = "FPC1145"
config FPC_FINGERPRINT
	bool "FPC Fingerprint"
	default y
	---help---
	FPC fingerprint FPC's 102x/104x device.
endif

if MTK_FINGERPRINT_SELECT = "GF318M"
config GOODIX_FINGERPRINT
	bool "Goodix Fingerprint"
	default y
	---help---
	Goodix Fingerprint chip GF516/GF318GF316M/GF616M/GF318M TEE driver

endif
endif
endmenu
```

## Qualcomm/kernel-3.18/drivers/input/fingerprint/Kconfig
```kconfig
#
# Zeitecsemi fingerprint sensor drivers configuration
#

menuconfig ZET_FINGERPRINT_SENSOR
	bool "Zeitecsemi FingerPrint Sensor Miscellaneous devices"
	default y
	help
	  Say Y here, and a list of miscellaneous input drivers will be displayed.
	  Everything that didn't fit into the other categories is here. This option
	  doesn't affect the kernel.

	  If unsure, say Y.

if ZET_FINGERPRINT_SENSOR

config ZET_FP_SENSOR_CORE
	tristate "zeitecsemi fingerprint sensor driver"
	depends on SPI && INPUT

	default y
	help
          The Zeitecsemi fingerprint sensor driver core
          Say Y here to enable the feature.

          
endif
```
